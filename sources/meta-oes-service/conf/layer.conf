## sources/meta-oes-service/conf/layer.conf
```bitbake
# We have a conf and classes directory, add to BBPATH
BBPATH .= ":${LAYERDIR}"

# We have recipes-* directories, add to BBFILES
BBFILES += "${LAYERDIR}/recipes-*/*/*.bb \
            ${LAYERDIR}/recipes-*/*/*.bbappend"

BBFILE_COLLECTIONS += "meta-oes-service"
BBFILE_PATTERN_meta-oes-service = "^${LAYERDIR}/"
BBFILE_PRIORITY_meta-oes-service = "6"

LAYERDEPENDS_meta-oes-service = "core"
LAYERSERIES_COMPAT_meta-oes-service = "kirkstone"
```

## sources/meta-oes/conf/layer.conf
```bitbake
# We have a conf and classes directory, add to BBPATH
BBPATH .= ":${LAYERDIR}"

# We have recipes-* directories, add to BBFILES
BBFILES += "${LAYERDIR}/recipes-*/*/*.bb \
            ${LAYERDIR}/recipes-*/*/*.bbappend"

BBFILE_COLLECTIONS += "meta-oes"
BBFILE_PATTERN_meta-oes = "^${LAYERDIR}/"
BBFILE_PRIORITY_meta-oes = "6"

LAYERDEPENDS_meta-oes = "core"
LAYERSERIES_COMPAT_meta-oes = "kirkstone"
```

## sources/meta-toradex-nxp/conf/machine/apalis-imx8.conf
```bitbake
#@TYPE: Machine
#@NAME: Toradex Apalis iMX8
#@DESCRIPTION: Toradex Apalis iMX8 powered by a i.MX 8QuadMax SoC
#@MAINTAINER: Stefan Agner <stefan.agner@toradex.com>

MACHINE_NAME = "Apalis-iMX8"

SOC_SILICON_REV ?= ""

MACHINEOVERRIDES =. "mx8:mx8qm:"

IMX_DEFAULT_BSP = "nxp"

require conf/machine/include/imx-base.inc
# override imx-base.inc which sets this to cortexa72-cortexa53-crypto
DEFAULTTUNE:mx8qm-generic-bsp = "armv8a-crypto"
require conf/machine/include/arm/armv8a/tune-cortexa72-cortexa53.inc

# Don't include kernels in standard images
RRECOMMENDS:${KERNEL_PACKAGE_NAME}-base = ""

LOADADDR = ""

# we do not want to have getty running on tty1 as we run
# auto-serial-console there
USE_VT = "0"

KERNEL_DEVICETREE = " \
    freescale/imx8qm-apalis-eval.dtb \
    freescale/imx8qm-apalis-ixora-v1.1.dtb \
    freescale/imx8qm-apalis-v1.1-eval.dtb \
    freescale/imx8qm-apalis-v1.1-ixora-v1.1.dtb \
    freescale/imx8qm-apalis-v1.1-ixora-v1.2.dtb \
    freescale/imx8qp-apalis-v1.1-eval.dtb \
    freescale/imx8qp-apalis-v1.1-ixora-v1.1.dtb	\
    freescale/imx8qp-apalis-v1.1-ixora-v1.2.dtb \
"

KERNEL_IMAGETYPE:aarch64 = "Image.gz"

UBOOT_SUFFIX = "bin"
UBOOT_CONFIG ??= "sd"
UBOOT_CONFIG[sd] = "apalis-imx8_defconfig,sdcard"

UBOOT_ENTRYPOINT = "0x96000000"
UBOOT_DTB_LOADADDRESS = "0x83000000"
UBOOT_DTBO_LOADADDRESS = "0x83100000"
UBOOT_RD_LOADADDRESS = "0xA0000000"

ATF_PLATFORM = "imx8qm"

BOOT_SPACE = "65536"
IMX_BOOT_SEEK = "32"

IMAGE_BOOT_FILES:append = " boot.scr-${MACHINE};boot.scr hdmitxfw.bin dpfw.bin"
WKS_FILE_DEPENDS:append = " u-boot-default-script"
PREFERRED_PROVIDER_u-boot-default-script = "u-boot-distro-boot"

PREFERRED_PROVIDER_virtual/kernel = "linux-toradex"
PREFERRED_PROVIDER_virtual/kernel:preempt-rt = "linux-toradex"
PREFERRED_PROVIDER_virtual/bootloader = "u-boot-toradex"
PREFERRED_PROVIDER_u-boot = "u-boot-toradex"
# Currently we use the nxp 2020.04 downstream for mx8 as some features are
# not yet available in 2020.07.
PREFERRED_VERSION_u-boot-toradex = "2020.04%"

MACHINE_FIRMWARE:append = " linux-firmware-pcie8997 firmware-imx-hdmi firmware-imx-vpu-imx8"

IMXBOOT_TARGETS = "flash_b0"
IMX_BOOT_SOC_TARGET = "iMX8QM"

PREFERRED_PROVIDER_imx-sc-firmware = "imx-sc-firmware-toradex"
BOARD_TYPE = "apalis"

IMAGE_CLASSES:append = " image_type_tezi"
IMAGE_FSTYPES += "teziimg"

# The imx-boot container takes care for the i.MX 8 offset, so the container
# has to be flashed at offset 0 directly
UBOOT_BINARY_TEZI_EMMC = "imx-boot"
OFFSET_BOOTROM_PAYLOAD = "0"

TEZI_EXTERNAL_KERNEL_DEVICETREE_BOOT = "apalis-imx8_hdmi_overlay.dtbo"

TORADEX_PRODUCT_IDS = "0037 0047 0048 0049 0067"
TORADEX_PRODUCT_IDS[0037] = "imx8qm-apalis-v1.1-eval.dtb"
TORADEX_PRODUCT_IDS[0047] = "imx8qm-apalis-v1.1-eval.dtb"
TORADEX_PRODUCT_IDS[0048] = "imx8qp-apalis-v1.1-eval.dtb"
TORADEX_PRODUCT_IDS[0049] = "imx8qp-apalis-v1.1-eval.dtb"
TORADEX_PRODUCT_IDS[0067] = "imx8qm-apalis-v1.1-eval.dtb"
```

## sources/meta-toradex-nxp/conf/machine/colibri-imx6ull-emmc.conf
```bitbake
#@TYPE: Machine
#@NAME: Toradex Colibri iMX6ULL 1GB (eMMC)
#@SOC: i.MX6ULL
#@DESCRIPTION: Machine configuration for Toradex Colibri iMX6 ULL 1GB (eMMC) SOM
#@MAINTAINER: Max Krummenacher <max.krummenacher@toradex.com>

MACHINEOVERRIDES =. "mx6:mx6ul:mx6ull:"

require conf/machine/include/imx-base.inc
require conf/machine/include/arm/armv7a/tune-cortexa7.inc

PREFERRED_PROVIDER_virtual/kernel:use-nxp-bsp ?= "linux-toradex"
PREFERRED_PROVIDER_virtual/kernel:preempt-rt = "linux-toradex"

PREFERRED_PROVIDER_virtual/kernel:use-mainline-bsp = "linux-toradex-mainline"
PREFERRED_PROVIDER_virtual/kernel:use-mainline-bsp:preempt-rt = "linux-toradex-mainline"
PREFERRED_PROVIDER_virtual/dtb:use-mainline-bsp = "device-tree-overlays-mainline"

KERNEL_DEVICETREE:use-mainline-bsp = " \
    imx6ull-colibri-emmc-eval-v3.dtb \
"
KERNEL_DEVICETREE:use-nxp-bsp = " \
    imx6ull-colibri-emmc-aster.dtb \
    imx6ull-colibri-emmc-eval-v3.dtb \
    imx6ull-colibri-emmc-iris.dtb \
    imx6ull-colibri-emmc-iris-v2.dtb \
"

KERNEL_IMAGETYPE = "zImage"
# The kernel lives in its own ubi volume.
RRECOMMENDS_${KERNEL_PACKAGE_NAME}-base = ""

IMX_DEFAULT_BOOTLOADER = "u-boot-toradex"
PREFERRED_PROVIDER_u-boot-default-script ?= "u-boot-script-toradex"
UBOOT_MAKE_TARGET = "u-boot.imx"
UBOOT_MACHINE ?= "colibri-imx6ull-emmc_defconfig"
UBOOT_SUFFIX = "imx"

IMAGE_FSTYPES += "tar.xz"
# wic support
IMAGE_BOOT_FILES:append = " boot.scr-${MACHINE};boot.scr"
WKS_FILE_DEPENDS:append = " u-boot-default-script"
WKS_FILE = "sdimage-bootpart.wks"

MACHINE_FEATURES += "screen usbgadget usbhost vfat ext2 alsa touchscreen wifi bluetooth 3g"
MACHINE_FIRMWARE:remove = "firmware-imx-epdc"
```

## sources/meta-toradex-nxp/conf/machine/colibri-imx7.conf
```bitbake
# cope with renamed machine file in meta-freescale-3rdparty
require conf/machine/colibri-imx7-nand.conf
```

## sources/meta-toradex-nxp/conf/machine/include/apalis-imx6.inc
```bitbake
IMAGE_CLASSES:append = " image_type_tezi"
IMAGE_FSTYPES:append = " teziimg"
TORADEX_PRODUCT_IDS = "0027 0028 0029 0035"
# The payload offsets are given in number of 512 byte blocks.
OFFSET_BOOTROM_PAYLOAD = "2"
OFFSET_SPL_PAYLOAD = "138"

MACHINE_NAME = "Apalis-iMX6"

KERNEL_DEVICETREE += "imx6q-apalis-ixora-v1.2.dtb"
KERNEL_DEVICETREE:use-mainline-bsp += " \
    imx6q-apalis-eval.dtb \
    imx6q-apalis-ixora-v1.1.dtb \
"

PREFERRED_PROVIDER_virtual/kernel = "linux-toradex"
PREFERRED_PROVIDER_virtual/kernel:preempt-rt = "linux-toradex"
PREFERRED_PROVIDER_virtual/kernel:use-mainline-bsp = "linux-toradex-mainline"
PREFERRED_PROVIDER_virtual/kernel:use-mainline-bsp:preempt-rt = "linux-toradex-mainline"
PREFERRED_PROVIDER_virtual/dtb:use-mainline-bsp = "device-tree-overlays-mainline"

IMX_DEFAULT_BOOTLOADER:apalis-imx6 = "u-boot"
PREFERRED_PROVIDER_u-boot-default-script = "u-boot-distro-boot"
UBOOT_SUFFIX = "img"

UBOOT_ENTRYPOINT:apalis-imx6 = "0x11000000"
UBOOT_DTB_LOADADDRESS:apalis-imx6 = "0x12100000"
UBOOT_DTBO_LOADADDRESS:apalis-imx6 = "0x17000000"

MACHINE_FIRMWARE:remove = "firmware-imx-epdc"

TEZI_EXTERNAL_KERNEL_DEVICETREE_BOOT = "apalis-imx6_hdmi_overlay.dtbo"
TEZI_EXTERNAL_KERNEL_DEVICETREE_BOOT:use-mainline-bsp = "apalis-imx6_parallel-rgb_overlay.dtbo display-edt7_overlay.dtbo apalis-imx6_stmpe-ts_overlay.dtbo apalis-imx6_hdmi_overlay.dtbo apalis-imx6_vga_overlay.dtbo"
```

## sources/meta-toradex-nxp/conf/machine/include/colibri-imx6.inc
```bitbake
IMAGE_CLASSES:append = " image_type_tezi"
IMAGE_FSTYPES:append = " teziimg"
TORADEX_PRODUCT_IDS = "0014 0015 0016 0017"
# The payload offsets are given in number of 512 byte blocks.
OFFSET_BOOTROM_PAYLOAD = "2"
OFFSET_SPL_PAYLOAD = "138"

MACHINE_NAME = "Colibri-iMX6"

TEZI_EXTERNAL_KERNEL_DEVICETREE_BOOT = "colibri-imx6_lcd-vga_overlay.dtbo colibri-imx6_stmpe-ts_overlay.dtbo"
TEZI_EXTERNAL_KERNEL_DEVICETREE_BOOT:use-mainline-bsp = "colibri-imx6_parallel-rgb_overlay.dtbo colibri-imx6_stmpe-ts_overlay.dtbo display-vga_overlay.dtbo"

KERNEL_DEVICETREE += " \
    imx6dl-colibri-iris.dtb \
    imx6dl-colibri-iris-v2.dtb \
"

PREFERRED_PROVIDER_virtual/kernel = "linux-toradex"
PREFERRED_PROVIDER_virtual/kernel:preempt-rt = "linux-toradex"
PREFERRED_PROVIDER_virtual/kernel:use-mainline-bsp = "linux-toradex-mainline"
PREFERRED_PROVIDER_virtual/kernel:use-mainline-bsp:preempt-rt = "linux-toradex-mainline"
PREFERRED_PROVIDER_virtual/dtb:use-mainline-bsp = "device-tree-overlays-mainline"

IMX_DEFAULT_BOOTLOADER:colibri-imx6 = "u-boot"
PREFERRED_PROVIDER_u-boot-default-script = "u-boot-distro-boot"
UBOOT_SUFFIX = "img"

MACHINE_FIRMWARE:remove = "firmware-imx-epdc"

UBOOT_ENTRYPOINT:colibri-imx6 = "0x11000000"
UBOOT_DTB_LOADADDRESS:colibri-imx6 = "0x12100000"
UBOOT_DTBO_LOADADDRESS:colibri-imx6 = "0x17000000"
```

## sources/meta-toradex-nxp/conf/machine/include/colibri-imx6ull-emmc.inc
```bitbake
IMAGE_CLASSES:append = " image_type_tezi"
IMAGE_FSTYPES:append = " teziimg"
# The payload offsets are given in number of 512 byte blocks.
OFFSET_BOOTROM_PAYLOAD = "2"
TORADEX_PRODUCT_IDS = "0062"
TORADEX_FLASH_TYPE = "emmc"

WIC_CREATE_EXTRA_ARGS:append = " --no-fstab-update"

MACHINE_NAME = "Colibri-iMX6ULL-eMMC"

IMX_DEFAULT_BOOTLOADER:colibri-imx6ull-emmc = "u-boot"
PREFERRED_PROVIDER_u-boot-default-script = "u-boot-distro-boot"
UBOOT_MAKE_TARGET:colibri-imx6ull-emmc = "u-boot.imx"
UBOOT_SUFFIX:colibri-imx6ull-emmc = "imx"
UBOOT_ENTRYPOINT:colibri-imx6ull-emmc = "0x81000000"
UBOOT_DTB_LOADADDRESS:colibri-imx6ull-emmc = "0x82100000"
UBOOT_DTBO_LOADADDRESS:colibri-imx6ull-emmc = "0x87000000"

TEZI_EXTERNAL_KERNEL_DEVICETREE_BOOT = "colibri-imx6ull_parallel-rgb_vga_overlay.dtbo colibri-imx6ull_ad7879_overlay.dtbo"
TEZI_EXTERNAL_KERNEL_DEVICETREE_BOOT:use-mainline-bsp = "colibri-imx6ull_parallel-rgb_overlay.dtbo colibri-imx6ull_ad7879_overlay.dtbo display-vga_overlay.dtbo"

PREFERRED_PROVIDER_virtual/kernel = "linux-toradex"
PREFERRED_PROVIDER_virtual/kernel:preempt-rt = "linux-toradex"
PREFERRED_PROVIDER_virtual/kernel:use-mainline-bsp = "linux-toradex-mainline"
PREFERRED_PROVIDER_virtual/kernel:use-mainline-bsp:preempt-rt = "linux-toradex-mainline"
PREFERRED_PROVIDER_virtual/dtb:use-mainline-bsp = "device-tree-overlays-mainline"
```

## sources/meta-toradex-nxp/conf/machine/include/colibri-imx6ull.inc
```bitbake
IMAGE_CLASSES:append = " image_type_tezi"
IMAGE_FSTYPES:append = " teziimg"
TORADEX_PRODUCT_IDS = "0036 0040 0044 0045"
TORADEX_PRODUCT_IDS[0036] = "imx6ull-colibri-eval-v3.dtb"
TORADEX_PRODUCT_IDS[0040] = "imx6ull-colibri-wifi-eval-v3.dtb"
TORADEX_PRODUCT_IDS[0044] = "imx6ull-colibri-eval-v3.dtb"
TORADEX_PRODUCT_IDS[0045] = "imx6ull-colibri-wifi-eval-v3.dtb"
TORADEX_FLASH_TYPE = "rawnand"

WIC_CREATE_EXTRA_ARGS:append = " --no-fstab-update"

MACHINE_NAME = "Colibri-iMX6ULL"

MACHINE_FIRMWARE:remove:use-mainline-bsp = "firmware-imx-vpu-imx6q firmware-imx-vpu-imx6d"

IMX_DEFAULT_BOOTLOADER:colibri-imx6ull = "u-boot"
PREFERRED_PROVIDER_u-boot-default-script = "u-boot-distro-boot"
UBOOT_MAKE_TARGET:colibri-imx6ull = "u-boot.imx"
UBOOT_ENTRYPOINT:colibri-imx6ull = "0x81000000"
UBOOT_DTB_LOADADDRESS:colibri-imx6ull = "0x82100000"
UBOOT_DTBO_LOADADDRESS:colibri-imx6ull = "0x87000000"

KERNEL_DEVICETREE:append:use-nxp-bsp = " \
    imx6ull-colibri-aster.dtb \
    imx6ull-colibri-iris.dtb \
    imx6ull-colibri-iris-v2.dtb \
    imx6ull-colibri-wifi-aster.dtb \
    imx6ull-colibri-wifi-iris.dtb \
    imx6ull-colibri-wifi-iris-v2.dtb \
"

PREFERRED_PROVIDER_virtual/kernel = "linux-toradex"
PREFERRED_PROVIDER_virtual/kernel:preempt-rt = "linux-toradex"
PREFERRED_PROVIDER_virtual/kernel:use-mainline-bsp = "linux-toradex-mainline"
PREFERRED_PROVIDER_virtual/kernel:use-mainline-bsp:preempt-rt = "linux-toradex-mainline"
PREFERRED_PROVIDER_virtual/dtb:use-mainline-bsp = "device-tree-overlays-mainline"
```

## sources/meta-toradex-nxp/conf/machine/include/colibri-imx7-emmc.inc
```bitbake
IMAGE_CLASSES:append = " image_type_tezi"
IMAGE_FSTYPES:append = " teziimg"
# The payload offsets are given in number of 512 byte blocks.
OFFSET_BOOTROM_PAYLOAD = "2"
TORADEX_PRODUCT_IDS = "0039"
TORADEX_FLASH_TYPE = "emmc"

MACHINE_NAME = "Colibri-iMX7-eMMC"

MACHINE_FIRMWARE:remove = "firmware-imx-epdc"
MACHINE_FIRMWARE:remove:use-mainline-bsp = "firmware-imx-vpu-imx6q firmware-imx-vpu-imx6d"

PREFERRED_PROVIDER_virtual/kernel = "linux-toradex"
PREFERRED_PROVIDER_virtual/kernel:preempt-rt = "linux-toradex"
PREFERRED_PROVIDER_virtual/kernel:use-mainline-bsp = "linux-toradex-mainline"
PREFERRED_PROVIDER_virtual/kernel:use-mainline-bsp:preempt-rt = "linux-toradex-mainline"
PREFERRED_PROVIDER_virtual/dtb:use-mainline-bsp = "device-tree-overlays-mainline"

KERNEL_DEVICETREE:append:use-nxp-bsp = " \
    imx7d-colibri-emmc-iris.dtb \
    imx7d-colibri-emmc-iris-v2.dtb \
"
KERNEL_DEVICETREE:append:use-mainline-bsp = " \
    imx7d-colibri-emmc-aster.dtb \
"

IMX_DEFAULT_BOOTLOADER:colibri-imx7-emmc = "u-boot"
PREFERRED_PROVIDER_u-boot-default-script = "u-boot-distro-boot"

TEZI_EXTERNAL_KERNEL_DEVICETREE_BOOT = "colibri-imx7_lcd-vga_overlay.dtbo colibri-imx7_ad7879_overlay.dtbo"
TEZI_EXTERNAL_KERNEL_DEVICETREE_BOOT:use-mainline-bsp = "colibri-imx7_parallel-rgb_overlay.dtbo colibri-imx7_ad7879_overlay.dtbo display-vga_overlay.dtbo"

UBOOT_BINARY:colibri-imx7-emmc = "u-boot.imx"
UBOOT_DTB_LOADADDRESS:colibri-imx7-emmc = "0x82000000"
UBOOT_DTBO_LOADADDRESS:colibri-imx7-emmc = "0x87000000"
UBOOT_ENTRYPOINT:colibri-imx7-emmc = "0x81000000"
UBOOT_MAKE_TARGET = "u-boot.imx"
UBOOT_SUFFIX:${MACHINE} = "imx"
```

## sources/meta-toradex-nxp/conf/machine/include/colibri-imx7.inc
```bitbake
IMAGE_CLASSES:append = " image_type_tezi"
IMAGE_FSTYPES:append = " teziimg"
TORADEX_PRODUCT_IDS = "0032 0033 0041"
TORADEX_PRODUCT_IDS[0032] = "imx7s-colibri-eval-v3.dtb"
TORADEX_PRODUCT_IDS[0033] = "imx7d-colibri-eval-v3.dtb"
TORADEX_PRODUCT_IDS[0041] = "imx7d-colibri-eval-v3.dtb"
TORADEX_FLASH_TYPE = "rawnand"

MACHINE_NAME = "Colibri-iMX7"

MACHINE_FIRMWARE:remove = "firmware-imx-epdc"
MACHINE_FIRMWARE:remove:use-mainline-bsp = "firmware-imx-vpu-imx6q firmware-imx-vpu-imx6d"

KERNEL_DEVICETREE:append:use-nxp-bsp = " \
    imx7d-colibri-iris.dtb \
    imx7d-colibri-iris-v2.dtb \
    imx7s-colibri-iris.dtb \
    imx7s-colibri-iris-v2.dtb \
"
KERNEL_DEVICETREE:append:use-mainline-bsp = " \
    imx7d-colibri-aster.dtb \
    imx7s-colibri-aster.dtb \
"

PREFERRED_PROVIDER_virtual/kernel = "linux-toradex"
PREFERRED_PROVIDER_virtual/kernel:preempt-rt = "linux-toradex"
PREFERRED_PROVIDER_virtual/kernel:use-mainline-bsp = "linux-toradex-mainline"
PREFERRED_PROVIDER_virtual/kernel:use-mainline-bsp:preempt-rt = "linux-toradex-mainline"
PREFERRED_PROVIDER_virtual/dtb:use-mainline-bsp = "device-tree-overlays-mainline"

IMX_DEFAULT_BOOTLOADER:colibri-imx7 = "u-boot"
PREFERRED_PROVIDER_u-boot-default-script = "u-boot-distro-boot"

UBOOT_MAKE_TARGET:colibri-imx7 = "u-boot.imx"
UBOOT_ENTRYPOINT:colibri-imx7 = "0x81000000"
UBOOT_DTB_LOADADDRESS:colibri-imx7 = "0x82000000"
UBOOT_DTBO_LOADADDRESS:colibri-imx7 = "0x87000000"
```
