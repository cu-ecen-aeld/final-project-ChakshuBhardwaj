## sources/meta-toradex-nxp/conf/machine/verdin-imx8mm.conf
```bitbake
#@TYPE: Machine
#@NAME: Toradex Verdin iMX8M Mini
#@SOC: i.MX8MM
#@DESCRIPTION: Machine configuration for Toradex Verdin iMX8M Mini SoM
#@MAINTAINER: Max Krummenacher <max.krummenacher@toradex.com>

MACHINE_NAME = "Verdin-iMX8MM"

MACHINEOVERRIDES =. "mx8:mx8m:mx8mm:"

IMX_DEFAULT_BSP = "nxp"
IMX_DEFAULT_BSP:upstream = "mainline"

require conf/machine/include/imx-base.inc
# override imx-base.inc which sets this to cortexa53-crypto
DEFAULTTUNE:mx8mm-generic-bsp = "armv8a-crypto"
require conf/machine/include/arm/armv8a/tune-cortexa53.inc

# Don't include kernels in standard images
RRECOMMENDS:${KERNEL_PACKAGE_NAME}-base = ""

KERNEL_DEVICETREE = " \
    freescale/imx8mm-verdin-nonwifi-dahlia.dtb \
    freescale/imx8mm-verdin-nonwifi-dev.dtb \
    freescale/imx8mm-verdin-wifi-dahlia.dtb \
    freescale/imx8mm-verdin-wifi-dev.dtb \
"
KERNEL_IMAGETYPE:aarch64 = "Image.gz"

UBOOT_CONFIG ??= "sd"
UBOOT_CONFIG[sd] = "verdin-imx8mm_defconfig,sdcard"
SPL_BINARY = "spl/u-boot-spl.bin"

UBOOT_ENTRYPOINT_mx8mm  = "0x40000000"
UBOOT_DTB_LOADADDRESS_mx8mm = "0x44000000"
UBOOT_DTBO_LOADADDRESS_mx8mm = "0x46000000"
UBOOT_RD_LOADADDRESS = "0x60000000"

# Set DDR FIRMWARE
DDR_FIRMWARE_NAME = "lpddr4_pmu_train_1d_imem.bin lpddr4_pmu_train_1d_dmem.bin lpddr4_pmu_train_2d_imem.bin lpddr4_pmu_train_2d_dmem.bin"

ATF_PLATFORM = "imx8mm"

# Set u-boot DTB
UBOOT_DTB_NAME = "imx8mm-verdin.dtb"

BOOT_SPACE = "65536"

# Set imx-mkimage boot target
IMXBOOT_TARGETS = "flash_evk_emmc_fastboot"
IMX_BOOT_SOC_TARGET = "iMX8MM"

IMAGE_BOOT_FILES:append = " boot.scr-${MACHINE};boot.scr"
WKS_FILE_DEPENDS:append = " u-boot-default-script"
PREFERRED_PROVIDER_u-boot-default-script = "u-boot-distro-boot"

LOADADDR = ""
UBOOT_SUFFIX = "bin"
UBOOT_MAKE_TARGET = ""
IMX_BOOT_SEEK = "33"

SERIAL_CONSOLES = "115200;ttymxc0"

MACHINE_FEATURES += "3g bluetooth alsa ext2 pci screen touchscreen usbgadget usbhost vfat wifi"


# Add additional firmware
MACHINE_FIRMWARE:append = " linux-firmware-ath10k linux-firmware-imx-sdma-imx7d"

PREFERRED_PROVIDER_virtual/kernel = "linux-toradex"
PREFERRED_PROVIDER_virtual/kernel:preempt-rt = "linux-toradex"
PREFERRED_PROVIDER_virtual/kernel:use-mainline-bsp = "linux-toradex-mainline"
PREFERRED_PROVIDER_virtual/kernel:use-mainline-bsp:preempt-rt = "linux-toradex-mainline"
MACHINE_EXTRA_RRECOMMENDS:append:use-mainline-bsp = " modprobe-conf"

IMX_DEFAULT_BOOTLOADER = "u-boot-toradex"
# Currently we use the nxp 2020.04 downstream for mx8 as some features are
# not yet available in 2020.07.
PREFERRED_VERSION_u-boot-toradex = "2020.04%"
# With use-mainline-bsp build mainline U-Boot
IMX_DEFAULT_BOOTLOADER:use-mainline-bsp = "u-boot"
# if using the mainline u-boot, build imx-boot from within u-boot
MACHINEOVERRIDES:prepend:use-mainline-bsp = "imx-boot-container:"
# variables to control imx-boot with u-boot
ATF_LOAD_ADDR = "0x920000"
IMX_EXTRA_FIRMWARE = "firmware-imx-8m"
TEE_LOAD_ADDR = "0xbe000000"
UBOOT_MAKE_TARGET:use-mainline-bsp = "all"

MACHINE_FIRMWARE:append = " linux-firmware-sd8997"
MACHINE_FIRMWARE:append = " firmware-imx-vpu-imx8"

BOARD_TYPE = "verdin"

IMAGE_CLASSES:append = " image_type_tezi"
IMAGE_FSTYPES += "teziimg"

UBOOT_BINARY_TEZI_EMMC = "imx-boot"
OFFSET_BOOTROM_PAYLOAD = "2"

TEZI_EXTERNAL_KERNEL_DEVICETREE_BOOT = "verdin-imx8mm_lt8912_overlay.dtbo"
TEZI_EXTERNAL_KERNEL_DEVICETREE_BOOT:use-mainline-bsp = ""

TORADEX_PRODUCT_IDS = "0055 0057 0059 0060 0068"
TORADEX_PRODUCT_IDS[0055] = "imx8mm-verdin-wifi-v1.1-dev.dtb"
TORADEX_PRODUCT_IDS[0057] = "imx8mm-verdin-nonwifi-v1.1-dev.dtb"
TORADEX_PRODUCT_IDS[0059] = "imx8mm-verdin-nonwifi-v1.1-dev.dtb"
TORADEX_PRODUCT_IDS[0060] = "imx8mm-verdin-wifi-v1.1-dev.dtb"
TORADEX_PRODUCT_IDS[0068] = "imx8mm-verdin-wifi-v1.1-dev.dtb"
```

## sources/meta-toradex-nxp/conf/machine/verdin-imx8mp.conf
```bitbake
#@TYPE: Machine
#@NAME: Toradex Verdin iMX8M Plus
#@SOC: i.MX8MP
#@DESCRIPTION: Machine configuration for Toradex Verdin iMX8M Plus SoM
#@MAINTAINER: Max Krummenacher <max.krummenacher@toradex.com>

MACHINE_NAME = "Verdin-iMX8MP"

MACHINEOVERRIDES =. "mx8:mx8m:mx8mp:"

IMX_DEFAULT_BSP = "nxp"
IMX_DEFAULT_BSP:upstream = "mainline"

require conf/machine/include/imx-base.inc
# override imx-base.inc which sets this to cortexa53-crypto
DEFAULTTUNE:mx8mp-generic-bsp = "armv8a-crypto"
require conf/machine/include/arm/armv8a/tune-cortexa53.inc

# Don't include kernels in standard images
RRECOMMENDS:${KERNEL_PACKAGE_NAME}-base = ""

KERNEL_DEVICETREE = " \
    freescale/imx8mp-verdin-nonwifi-dahlia.dtb \
    freescale/imx8mp-verdin-nonwifi-dev.dtb \
    freescale/imx8mp-verdin-wifi-dahlia.dtb \
    freescale/imx8mp-verdin-wifi-dev.dtb \
"
KERNEL_IMAGETYPE:aarch64 = "Image.gz"

UBOOT_CONFIG ??= "sd"
UBOOT_CONFIG[sd] = "verdin-imx8mp_defconfig,sdcard"
SPL_BINARY = "spl/u-boot-spl.bin"

UBOOT_ENTRYPOINT_mx8mp  = "0x40000000"
UBOOT_DTB_LOADADDRESS_mx8mp = "0x44000000"
UBOOT_DTBO_LOADADDRESS_mx8mp = "0x46000000"
UBOOT_RD_LOADADDRESS = "0x60000000"

# Set u-boot DTB
UBOOT_DTB_NAME = "imx8mp-verdin.dtb"

# Set DDR FIRMWARE
LPDDR_FW_VERSION = "_202006"
DDR_FIRMWARE_NAME = " \
    lpddr4_pmu_train_1d_dmem${LPDDR_FW_VERSION}.bin \
    lpddr4_pmu_train_1d_imem${LPDDR_FW_VERSION}.bin \
    lpddr4_pmu_train_2d_dmem${LPDDR_FW_VERSION}.bin \
    lpddr4_pmu_train_2d_imem${LPDDR_FW_VERSION}.bin \
"

ATF_PLATFORM = "imx8mp"

BOOT_SPACE = "65536"
IMAGE_BOOTLOADER = "imx-boot"

# Set imx-mkimage boot target
IMXBOOT_TARGETS = "flash_evk_emmc_fastboot"
IMX_BOOT_SOC_TARGET = "iMX8MP"

IMAGE_BOOT_FILES:append = " boot.scr-${MACHINE};boot.scr"
WKS_FILE_DEPENDS:append = " u-boot-default-script"
PREFERRED_PROVIDER_u-boot-default-script = "u-boot-distro-boot"

LOADADDR = ""
UBOOT_SUFFIX = "bin"
UBOOT_MAKE_TARGET = ""
IMX_BOOT_SEEK = "32"

SERIAL_CONSOLES = "115200;ttymxc2"

MACHINE_FEATURES += "3g bluetooth alsa ext2 pci screen touchscreen usbgadget usbhost vfat wifi"

PREFERRED_PROVIDER_virtual/kernel = "linux-toradex"
PREFERRED_PROVIDER_virtual/kernel:preempt-rt = "linux-toradex"
PREFERRED_PROVIDER_virtual/kernel:use-mainline-bsp = "linux-toradex-mainline"
PREFERRED_PROVIDER_virtual/kernel:use-mainline-bsp:preempt-rt = "linux-toradex-mainline"

IMX_DEFAULT_BOOTLOADER = "u-boot-toradex"
# Currently we use the nxp 2020.04 downstream for mx8 as some features are
# not yet available in 2020.07.
PREFERRED_VERSION_u-boot-toradex = "2020.04%"
# With use-mainline-bsp build mainline U-Boot
IMX_DEFAULT_BOOTLOADER:use-mainline-bsp = "u-boot"
# if using the mainline u-boot, build imx-boot from within u-boot
MACHINEOVERRIDES:prepend:use-mainline-bsp = "imx-boot-container:"
# variables to control imx-boot with u-boot
ATF_LOAD_ADDR = "0x920000"
IMX_EXTRA_FIRMWARE = "firmware-imx-8m"
TEE_LOAD_ADDR = "0xbe000000"
UBOOT_MAKE_TARGET:use-mainline-bsp = "all"

# handle machine firmware
MACHINE_FIRMWARE:append = " linux-firmware-sd8997"
MACHINE_FIRMWARE:remove = "firmware-sof-imx"

IMAGE_CLASSES:append = " image_type_tezi"
IMAGE_FSTYPES += "teziimg"

UBOOT_BINARY_TEZI_EMMC = "imx-boot"
OFFSET_BOOTROM_PAYLOAD = "0"

TEZI_EXTERNAL_KERNEL_DEVICETREE_BOOT = "verdin-imx8mp_native-hdmi_overlay.dtbo verdin-imx8mp_lt8912_overlay.dtbo"
TEZI_EXTERNAL_KERNEL_DEVICETREE_BOOT:use-mainline-bsp = ""

TORADEX_PRODUCT_IDS = "0058 0061 0063 0064 0066"
TORADEX_PRODUCT_IDS[0058] = "imx8mp-verdin-wifi-dev.dtb"
TORADEX_PRODUCT_IDS[0061] = "imx8mp-verdin-nonwifi-dev.dtb"
TORADEX_PRODUCT_IDS[0063] = "imx8mp-verdin-nonwifi-dev.dtb"
TORADEX_PRODUCT_IDS[0064] = "imx8mp-verdin-wifi-dev.dtb"
TORADEX_PRODUCT_IDS[0066] = "imx8mp-verdin-wifi-dev.dtb"
```
